## Kconfig
```kconfig
DT_COMPAT_ZMK_BEHAVIOR_CAPSLOCK := zmk,behavior-capslock

config ZMK_BEHAVIOR_CAPSLOCK
    bool
    default $(dt_compat_enabled,$(DT_COMPAT_ZMK_BEHAVIOR_CAPSLOCK))
    select ZMK_HID_INDICATORS
```
